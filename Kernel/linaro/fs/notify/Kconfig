## Kernel/linaro/mstar2/drv/cma_pool/Kconfig
```kconfig
config MSTAR_CMAPOOL
bool  "CMA POOL"
depends on CMA
 
help
    MStar CMA POOL driver function
    
```

## Kernel/linaro/mstar2/drv/cpuidle/Kconfig
```kconfig
config MSTAR_CPU_IDLE
	bool "CPU Idle Driver for Mstar processors"
	depends on CPU_IDLE
	default y
	help
	  Select this to enable cpuidle on Mstar processors.
```

## Kernel/linaro/mstar2/drv/dvfs/Kconfig
```kconfig
config MSTAR_DVFS
bool "Mstar Dynamic Voltage and Frequency Scaling"
depends on CPU_FREQ
default n

---help---
    To enable or to disable Mstar dynamic voltage and frequency scaling mechanism

config MSTAR_IR_BOOST
bool "IR Boost"
depends on MSTAR_DVFS
default n

---help---
    Increasing CPU clock when receiving a event from input devices
```

## Kernel/linaro/mstar2/drv/ldm/Kconfig
```kconfig
config HAS_LD
	tristate "Local Dimming"
	help
	    enable MStar local dimming driver.
	    
```

## Kernel/linaro/mstar2/drv/mali/Kconfig
```kconfig
menu "Mali/UMP"

choice
	prompt "Version"
	default MALI400_VERSION_NONE

config MALI400_VERSION_NONE
	bool "None"
config MALI400_VERSION_R3P2_01REL3
	bool "r3p2-01rel3"

endchoice

choice
	prompt "Platform"
	default MALI400_PLATFORM_NONE

config MALI400_PLATFORM_NONE
	bool "None"
config MALI400_PLATFORM_SUPERNOVA
	bool "Supernova"
config MALI400_PLATFORM_ANDROID_JELLYBEAN
	bool "Android Jelly Bean"
config MALI400_PLATFORM_ANDROID_JELLYBEAN_MR1
	bool "Android Jelly Bean MR1"
	depends on SYNC
config MALI400_PLATFORM_ANDROID_JELLYBEAN_MR2
	bool "Android Jelly Bean MR2"
	depends on SYNC

endchoice

if !(MALI400_VERSION_NONE || MALI400_PLATFORM_NONE)

config MALI400
	tristate "Mali-400/450 support"
	---help---
	  This enables support for the Mali-400, and Mali-450 GPUs.

	  To compile this driver as a module, choose M here: the module will be
	  called mali.

config MALI400_DEBUG
	bool "Enable debug in Mali driver"
	depends on MALI400
	---help---
	  This enabled extra debug checks and messages in the Mali driver.

config UMP
	tristate "UMP support"
	---help---
	  This enables support for the UMP memory allocation and sharing API.

	  To compile this driver as a module, choose M here: the module will be
	  called ump.

config UMP_DEBUG
	bool "Enable extra debug in UMP"
	depends on UMP
	---help---
	  This enabled extra debug checks and messages in UMP.

endif

endmenu
```

## Kernel/linaro/mstar2/drv/mbx/Kconfig
```kconfig
config MSTAR_MBX
tristate "MBX"
default y
help
    enable MStar MBX driver.

config MSTAR_MBX_U2K
tristate "MBX_U2K"
default n
help
    enable MStar MBX driver for Utopia2K
```

## Kernel/linaro/mstar2/drv/mtlb/Kconfig
```kconfig
config MSTAR_MTLB

tristate "MSTAR MTLB"
depends on MP_ION_PATCH_MSTAR_CUSTOMER_IOCTL 

help
    MStar mtlb driver function
default n
    
```

## Kernel/linaro/mstar2/drv/software_ir/Kconfig
```kconfig
config MSTAR_SOFTWARE_IR_MODULE

tristate "Software IrDA"

help
    MStar SoftwareIrDA driver function
```
