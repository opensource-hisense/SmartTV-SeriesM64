## Kernel/linaro/fs/notify/Kconfig
```kconfig
config FSNOTIFY
	def_bool y

source "fs/notify/dnotify/Kconfig"
source "fs/notify/inotify/Kconfig"
source "fs/notify/fanotify/Kconfig"
```

## Kernel/linaro/mstar/mstar/dvfs/Kconfig
```kconfig
config MSTAR_DVFS
bool "Mstar Dynamic Voltage and Frequency Scaling"
depends on CPU_FREQ
default n

---help---
    To enable or to disable Mstar dynamic voltage and frequency scaling mechanism
```

## Kernel/linaro/mstar/mstar/fusion_9_00/Kconfig
```kconfig
config MSTAR_FUSION_9_00
	tristate "Fusion9.0.0"
	---help---
	  Fusion is the IPC API used by DirectFB and FusionSound.
```

## Kernel/linaro/mstar/mstar/fusion_9_02/Kconfig
```kconfig
config MSTAR_FUSION_9_02
	tristate "Fusion9.0.2"
	---help---
	  Fusion is the IPC API used by DirectFB and FusionSound.
```

## Kernel/linaro/mstar/mstar/ion_mtlb/Kconfig
```kconfig
config MSTAR_ION_MTLB

tristate "MSTAR ION MTLB"
depends on MP_ION_PATCH_MSTAR_CUSTOMER_IOCTL

help
    MStar ion mtlb driver function
default n
    
```

## Kernel/linaro/mstar/mstar/miu/Kconfig
```kconfig
config MSTAR_MIU

tristate "MSTAR MIU"
depends on MSTAR_CMAPOOL

help
    MStar miu driver
default n
    
```

## Kernel/linaro/mstar/mstar/sar/Kconfig
```kconfig
config MSTAR_SAR

tristate "SAR"
default n

---help---
Enable compilation option for driver SAR


config MSTAR_DVFS_ENABLE
    bool "Enable Mstar DVFS"
    depends on MSTAR_SAR
    #depends on (EXT_PLATFORM_FLAG="general") || (EXT_PLATFORM_FLAG="tvos")
    default n
    help
        Select if you want to enable DVFS. If unsure, say 'N'.
```

## Kernel/linaro/mstar/mstar/xc/Kconfig
```kconfig
config MSTAR_XC
tristate "XC"
help
    enable MStar XC driver.

if MSTAR_XC

if MSTAR_TITANIA3
if MSTAR_GPIO
config MSTAR_3D_LR_REPORT
  bool "Support 3D LR Report"
  default n
  help
    Support 3D LR report
endif
endif


config VERSION
  string
  option env="VERSION"

endif
```
